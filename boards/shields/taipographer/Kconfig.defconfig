## boards/shields/taipographer/Kconfig.defconfig
```kconfig
if SHIELD_TAIPOGRAPHER_LEFT

    # Name must be less than 16 characters long!
    config ZMK_KEYBOARD_NAME
        default "Taipographer"

    config ZMK_SPLIT_ROLE_CENTRAL
        default y

    config ZMK_USB
        default y

    endif

if SHIELD_TAIPOGRAPHER_LEFT || SHIELD_TAIPOGRAPHER_RIGHT

    config ZMK_BLE
        default y

    config ZMK_SPLIT
        default y

    endif
```

## boards/shields/taipographer/Kconfig.shield
```kconfig
config SHIELD_TAIPOGRAPHER_LEFT
  def_bool $(shields_list_contains,taipographer_left)

    config ZMK_COMBO_MAX_PRESSED_COMBOS
        default 16

    config ZMK_COMBO_MAX_COMBOS_PER_KEY
        default 100

config SHIELD_TAIPOGRAPHER_RIGHT
  def_bool $(shields_list_contains,taipographer_right)

    config ZMK_COMBO_MAX_PRESSED_COMBOS
        default 16

    config ZMK_COMBO_MAX_COMBOS_PER_KEY
        default 100
```
